## meta-lava-dispatcher/conf/layer.conf
```bitbake
# We have a conf and classes directory, add to BBPATH
BBPATH .= ":${LAYERDIR}"

# We have recipes-* directories, add to BBFILES
BBFILES += "${LAYERDIR}/*.bb \
	${LAYERDIR}/*.bbappend"

BBFILE_COLLECTIONS += "lava-dispatcher"
BBFILE_PATTERN_lava-dispatcher = "^${LAYERDIR}/"
BBFILE_PRIORITY_lava-dispatcher = "6"
```
